#include "Oled.h"

const unsigned char F6x8[][6] =
{
    { 0x00, 0x00, 0x00, 0x00, 0x00, 0x00 },   // sp
    { 0x00, 0x00, 0x00, 0x2f, 0x00, 0x00 },   // !
    { 0x00, 0x00, 0x07, 0x00, 0x07, 0x00 },   // "
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    { 0x14, 0x14, 0x14, 0x14, 0x14, 0x14 }    // horiz lines
};

const unsigned char F8X16[]=
{
    0x00,0x00,0x00,0x00,0x00,0x00,0x00,0x00,0x00,0x00,0x00,0x00,0x00,0x00,0x00,0x00,// 0
    0x00,0x00,0x00,0xF8,0x00,0x00,0x00,0x00,0x00,0x00,0x00,0x33,0x30,0x00,0x00,0x00,//!1
    0x00,0x10,0x0C,0x06,0x10,0x0C,0x06,0x00,0x00,0x00,0x00,0x00,0x00,0x00,0x00,0x00,//"2
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    0x00,0x06,0x01,0x01,0x02,0x02,0x04,0x04,0x00,0x00,0x00,0x00,0x00,0x00,0x00,0x00,//~94
};

uint8_t SPI1_TX_Buff[20];

void SPI1_DMAConfig( void )
{
    DMA_InitTypeDef  DMA_InitStructure;
    NVIC_InitTypeDef NVIC_InitStructure ;

    RCC_AHB1PeriphClockCmd(RCC_AHB1Periph_DMA2, ENABLE); 

    //DMA发送中断设置
    NVIC_PriorityGroupConfig(NVIC_PriorityGroup_2);//设置系统中断优先级分组2
    NVIC_InitStructure.NVIC_IRQChannel = DMA2_Stream3_IRQn;
    NVIC_InitStructure.NVIC_IRQChannelPreemptionPriority = 0;
    NVIC_InitStructure.NVIC_IRQChannelSubPriority = 2;
    NVIC_InitStructure.NVIC_IRQChannelCmd = ENABLE;
    NVIC_Init(&NVIC_InitStructure);

    //DMA通道配置
    DMA_DeInit(DMA2_Stream3);
    DMA_InitStructure.DMA_Channel = DMA_Channel_3; 
    //外设地址
    DMA_InitStructure.DMA_PeripheralBaseAddr = (uint32_t)(&SPI1->DR);
    //内存地址
    DMA_InitStructure.DMA_Memory0BaseAddr = (uint32_t)SPI1_TX_Buff;
    //dma传输方向
    DMA_InitStructure.DMA_DIR = DMA_DIR_MemoryToPeripheral;
    //设置DMA在传输时缓冲区的长度
    DMA_InitStructure.DMA_BufferSize = 20;
    //设置DMA的外设递增模式，一个外设
    DMA_InitStructure.DMA_PeripheralInc = DMA_PeripheralInc_Disable;
    //设置DMA的内存递增模式
    DMA_InitStructure.DMA_MemoryInc = DMA_MemoryInc_Enable;
    //外设数据字长
    DMA_InitStructure.DMA_PeripheralDataSize = DMA_PeripheralDataSize_Byte;
    //内存数据字长
    DMA_InitStructure.DMA_MemoryDataSize = DMA_MemoryDataSize_Byte;
    //设置DMA的传输模式
    DMA_InitStructure.DMA_Mode = DMA_Mode_Normal;
    //设置DMA的优先级别
    DMA_InitStructure.DMA_Priority = DMA_Priority_High;	
    //指定如果FIFO模式或直接模式将用于指定的流 ： 不使能FIFO模式  
    DMA_InitStructure.DMA_FIFOMode = DMA_FIFOMode_Disable;    
    //指定了FIFO阈值水平
    DMA_InitStructure.DMA_FIFOThreshold = DMA_FIFOThreshold_HalfFull;        
    //指定的Burst转移配置内存传输 
    DMA_InitStructure.DMA_MemoryBurst = DMA_MemoryBurst_Single;       
    //指定的Burst转移配置外围转移 */  
    DMA_InitStructure.DMA_PeripheralBurst = DMA_PeripheralBurst_Single; 
    //配置DMA1的通道         
    DMA_Init(DMA2_Stream3, &DMA_InitStructure);  
    //使能中断
    DMA_ITConfig(DMA2_Stream3, DMA_IT_TC,ENABLE);   
    DMA_Cmd(DMA2_Stream3, ENABLE);
}

void OLED_GPIOConfig(void)
{
    GPIO_InitTypeDef  GPIO_InitStructure;
    SPI_InitTypeDef  SPI_InitStructure;

    RCC_AHB1PeriphClockCmd(RCC_AHB1Periph_GPIOB, ENABLE);
    RCC_APB2PeriphClockCmd(RCC_APB2Periph_SPI1, ENABLE);//使能SPI1时钟

    GPIO_InitStructure.GPIO_Pin = GPIO_Pin_1 | GPIO_Pin_2;
    GPIO_InitStructure.GPIO_Mode = GPIO_Mode_OUT;//普通输出模式
    GPIO_InitStructure.GPIO_OType = GPIO_OType_PP;//推挽输出
    GPIO_InitStructure.GPIO_Speed = GPIO_Speed_100MHz;//100MHz
    GPIO_InitStructure.GPIO_PuPd = GPIO_PuPd_UP;//上拉
    GPIO_Init(GPIOB, &GPIO_InitStructure);//初始化

    GPIO_InitStructure.GPIO_Pin = GPIO_Pin_3 | GPIO_Pin_4 | GPIO_Pin_5;//PB3~5复用功能输出	
    GPIO_InitStructure.GPIO_Mode = GPIO_Mode_AF;//复用功能
    GPIO_InitStructure.GPIO_OType = GPIO_OType_PP;//推挽输出
    GPIO_InitStructure.GPIO_Speed = GPIO_Speed_100MHz;//100MHz
    GPIO_InitStructure.GPIO_PuPd = GPIO_PuPd_UP;//上拉
    GPIO_Init(GPIOB, &GPIO_InitStructure);//初始化

    GPIO_PinAFConfig(GPIOB, GPIO_PinSource3, GPIO_AF_SPI1); //PB3复用为 SPI1
    GPIO_PinAFConfig(GPIOB, GPIO_PinSource4, GPIO_AF_SPI1); //PB4复用为 SPI1
    GPIO_PinAFConfig(GPIOB, GPIO_PinSource5, GPIO_AF_SPI1); //PB5复用为 SPI1

    SPI_InitStructure.SPI_Direction = SPI_Direction_2Lines_FullDuplex;
    SPI_InitStructure.SPI_Mode = SPI_Mode_Master;
    SPI_InitStructure.SPI_DataSize = SPI_DataSize_8b;
    SPI_InitStructure.SPI_CPOL = SPI_CPOL_High;
    SPI_InitStructure.SPI_CPHA = SPI_CPHA_2Edge;
    SPI_InitStructure.SPI_NSS = SPI_NSS_Soft;
    SPI_InitStructure.SPI_BaudRatePrescaler = SPI_BaudRatePrescaler_2;
    SPI_InitStructure.SPI_FirstBit = SPI_FirstBit_MSB;
    SPI_InitStructure.SPI_CRCPolynomial = 7;

    SPI_I2S_DMACmd(SPI1, SPI_I2S_DMAReq_Tx, ENABLE);            //发送缓冲区DMA使能
    SPI_Init(SPI1, &SPI_InitStructure);
    SPI_Cmd(SPI1, ENABLE); //使能SPI外设
    SPI1_DMAConfig();
}

/*******************************************************************************
* Function Name  : SPI1_Send
* Description    : SPI1的DMA方式发送
* Input          : SPI1_TX_Buff[SPI1_SendBufferSize]
* Output         : None
* Return         : None
* Attention      : 关闭DMA通道3之前必须等待TXE为1，等待忙标志为0
*******************************************************************************/
void DMA2_Stream3_IRQHandler(void)
{
    if(DMA_GetFlagStatus(DMA2_Stream3, DMA_FLAG_TCIF3)==SET)
    {  
        DMA_ClearFlag(DMA2_Stream3, DMA_FLAG_TCIF3);                        //清除传输完成中断
    }
}

void SPI1_Send(uint8_t *buff, uint16_t len)
{
    DMA_Cmd(DMA2_Stream3, DISABLE);
    DMA2_Stream3->M0AR = (uint32_t) buff;
    DMA2_Stream3->NDTR = len;
    DMA_Cmd(DMA2_Stream3, ENABLE);
}


void OLED_Writ_Bus(uint8_t da)                                           //串行数据写入
{
    /*
    while (SPI_I2S_GetFlagStatus(SPI1, SPI_I2S_FLAG_TXE) == RESET);
    SPI_I2S_SendData(SPI1, da);	

    while (SPI_I2S_GetFlagStatus(SPI1, SPI_I2S_FLAG_RXNE) == RESET);    //等待接收完一个byte
    SPI_I2S_ReceiveData(SPI1);                                          //返回通过SPIx最近接收的数据
    */
    SPI1_Send(&da, 1);
} 

void OLED_WrDat(unsigned char dat)
{
    OLED_DC_HIGH();
    OLED_Writ_Bus(dat);
}

void OLED_WrCmd(unsigned char cmd)
{
    OLED_DC_LOW();
    OLED_Writ_Bus(cmd);
}

void OLED_Set_Pos(unsigned char x, unsigned char y)
{ 
    OLED_WrCmd(0xb0+y);
    OLED_WrCmd(((x&0xf0)>>4)|0x10);
    OLED_WrCmd((x&0x0f)|0x00);
}

void OLED_Fill(unsigned char bmp_dat)
{
    unsigned char y,x;

    for(y=0;y<8;y++)
    {
        OLED_WrCmd(0xb0+y);
        OLED_WrCmd(0x01);
        OLED_WrCmd(0x10);

        for(x=0;x<X_WIDTH;x++)
        {
            OLED_WrDat(bmp_dat);
        }
    }
}

void OLED_CLS(void)
{
    unsigned char y, x;

    for(y=0;y<8;y++)
    {
        OLED_WrCmd(0xb0+y);
        OLED_WrCmd(0x01);
        OLED_WrCmd(0x10);

        for(x=0;x<X_WIDTH;x++)
        {
            OLED_WrDat(0);
        }
    }
}
 
void OLED_Init(void)
{
    OLED_GPIOConfig();

    //OLED_SCL_HIGH();
    OLED_RST_LOW();
    delay_ms(50);
    OLED_RST_HIGH();

    //从上电到下面开始初始化要有足够的时间，即等待RC复位完毕   

    OLED_WrCmd(0xae);//--turn off oled panel
    OLED_WrCmd(0x00);//---set low column address
    OLED_WrCmd(0x10);//---set high column address
    OLED_WrCmd(0x40);//--set start line address  Set Mapping RAM Display Start Line (0x00~0x3F)
    OLED_WrCmd(0x81);//--set contrast control register
    OLED_WrCmd(0xcf); // Set SEG Output Current Brightness
    OLED_WrCmd(0xa1);//--Set SEG/Column Mapping     0xa0左右反置 0xa1正常
    OLED_WrCmd(0xc8);//Set COM/Row Scan Direction   0xc0上下反置 0xc8正常
    OLED_WrCmd(0xa6);//--set normal display
    OLED_WrCmd(0xa8);//--set multiplex ratio(1 to 64)
    OLED_WrCmd(0x3f);//--1/64 duty
    OLED_WrCmd(0xd3);//-set display offset	Shift Mapping RAM Counter (0x00~0x3F)
    OLED_WrCmd(0x00);//-not offset
    OLED_WrCmd(0xd5);//--set display clock divide ratio/oscillator frequency
    OLED_WrCmd(0x80);//--set divide ratio, Set Clock as 100 Frames/Sec
    OLED_WrCmd(0xd9);//--set pre-charge period
    OLED_WrCmd(0xf1);//Set Pre-Charge as 15 Clocks & Discharge as 1 Clock
    OLED_WrCmd(0xda);//--set com pins hardware configuration
    OLED_WrCmd(0x12);
    OLED_WrCmd(0xdb);//--set vcomh
    OLED_WrCmd(0x40);//Set VCOM Deselect Level
    OLED_WrCmd(0x20);//-Set Page Addressing Mode (0x00/0x01/0x02)
    OLED_WrCmd(0x02);//
    OLED_WrCmd(0x8d);//--set Charge Pump enable/disable
    OLED_WrCmd(0x14);//--set(0x10) disable
    OLED_WrCmd(0xa4);// Disable Entire Display On (0xa4/0xa5)
    OLED_WrCmd(0xa6);// Disable Inverse Display On (0xa6/a7) 
    OLED_WrCmd(0xaf);//--turn on oled panel
    OLED_Fill(0x00);  //初始清屏
    OLED_Set_Pos(0,0);
} 
//==============================================================
//功能描述：写入一组标准ASCII字符
//参数：显示的位置（x,y），y为页范围0～7，要显示的字符串
//返回：无
//==============================================================
void OLED_P6x8Char(unsigned char x,unsigned char y,unsigned char ucData)
{
    unsigned char i, ucDataTmp;
    ucDataTmp = ucData - 32;

    if(x > 126)
    {
        x= 0;
        y++;
    }

    OLED_Set_Pos(x, y);

    for(i = 0; i < 6; i++)
    {
        OLED_WrDat(F6x8[ucDataTmp][i]);
    }
}
//==============================================================
//函数名：OLED_P6x8Str(unsigned char x,unsigned char y,unsigned char *p)
//功能描述：写入一组标准ASCII字符串
//参数：显示的位置（x,y），y为页范围0～7，要显示的字符串
//返回：无
//==============================================================  
void OLED_P6x8Str(unsigned char x,unsigned char y,unsigned char ch[])
{
    unsigned char c=0, i=0, j=0;

    while(ch[j] != '\0')
    {    
        c = ch[j] - 32;

        if(x > 126)
        {
            x = 0;
            y++;
        }

        OLED_Set_Pos(x,y);

        for(i=0; i<6; i++)
        {
          OLED_WrDat(F6x8[c][i]);
        }

        x += 6;
        j++;
    }
}
/****************************************************************
                   写6*8点阵数字函数
****************************************************************/
void OLED_P6x8Number(unsigned char x, unsigned char y, float number)
{
    unsigned char i = 0;
    unsigned char temp[16];
    unsigned char *point = temp;
    double decimal;
    int data;

    if(number<0)
    {
        temp[0] = '-';
        OLED_P6x8Char(x,y,temp[0]);
        x += 6;
        number = -number;
    }

    data = (int)number;
    decimal = number - data;              //得到小数部分

    if(data >= 1000)                    //是否可被1000整除
    {
        temp[i] = 48 + data / 1000;
        data = data % 1000;
        i++;
    }

    if(data >= 100)                     //是否可被100整除
    {
        temp[i]=48 + data/100;
        data = data%100;
        i++;
    }
    else if(data < 100 && i != 0)
    {
        temp[i] = 0 + 48;
        i++;
    }

    if(data >= 10)                      //是否可被10整除
    {
        temp[i] =48 + data / 10;
        data = data % 10;
        i++;
    }
    else if(data < 10 && i != 0)
    {
        temp[i] = 48;
        i++;
    }

    temp[i] = 48 + data;

    if(decimal >= 0.0001)             //判断是否为小数
    {
        i++;
        temp[i]='.';                //加小数点
        i++;
        data = (int)(decimal * 1000);
        temp[i] = 48 + data / 100;
        data = data % 100;
        i++;

        if(data > 0)
        {
            temp[i] = 48 + data / 10;
            data = data % 10;
        }

        if(data >= 0)
        {
            i++;
            temp[i] = data + 48;
        }
    }

    i++;
    temp[i] = '\0';
    OLED_P6x8Str(x,y,point);
}
//==============================================================
//功能描述：写入一组标准ASCII字符
//参数：显示的位置（x,y），y为页范围0～7，要显示的字符
//返回：无
//==============================================================
void OLED_P8x16Char(unsigned char x, unsigned char y, unsigned char ch)
{
    unsigned char c = 0, i = 0, j = 0;

    c = ch - 32;

    if(x > 120)
    {
        x = 0;
        y++;
    }

    OLED_Set_Pos(x,y);

    for(i=0;i<8;i++)
    {
        OLED_WrDat(F8X16[c * 16 + i]);
    }

    OLED_Set_Pos(x, y + 1);

    for(i = 0; i < 8; i++)
    {
        OLED_WrDat(F8X16[c * 16 + i + 8]);
    }

    x += 8;
    j++;
}
//==============================================================
//函数名：OLED_P8x16Str(unsigned char x,unsigned char y,unsigned char *p)
//功能描述：写入一组标准ASCII字符串
//参数：显示的位置（x,y），y为页范围0～7，要显示的字符串
//返回：无
//============================================================== 
void OLED_P8x16Str(unsigned char x, unsigned char y, unsigned char ch[])
{
    unsigned char c=0,i=0,j=0;

    while (ch[j]!='\0')
    {    
        c = ch[j] - 32;

        if(x > 120)
        {
            x=0;
            y++;
        }

        OLED_Set_Pos(x,y);

        for(i=0;i<8;i++)
        {
          OLED_WrDat(F8X16[c*16+i]);
        }

        OLED_Set_Pos(x,y+1);

        for(i=0;i<8;i++)
        {
          OLED_WrDat(F8X16[c*16+i+8]);
        }

        x+=8;
        j++;
    }
}
/****************************************************************
                   写8*16点阵数字函数
****************************************************************/
void OLED_P8x16Number(unsigned char x, unsigned char y, float number)
{
    unsigned char i=0;
    unsigned char temp[16];
    unsigned char *point=temp;
    double decimal;
    int data;

    if(number < 0)
    {
        temp[0] = '-';
        OLED_P8x16Char(x, y, temp[0]);
        x += 1;
        number = -number;
    }

    data = (int)number;
    decimal = number - data;              //得到小数部分

    if(data >= 1000)                    //是否可被1000整除
    {
        temp[i] = 48 + data / 1000;
        data = data % 1000;
        i++;
    }

    if(data >= 100)                     //是否可被100整除
    {
        temp[i]=48 + data/100;
        data = data%100;
        i++;
    }
    else if(data < 100 && i != 0)
    {
        temp[i] = 0 + 48;
        i++;
    }

    if(data >= 10)                      //是否可被10整除
    {
        temp[i] =48 + data / 10;
        data = data % 10;
        i++;
    }
    else if(data < 10 && i != 0)
    {
        temp[i] = 48;
        i++;
    }

    temp[i] = 48 + data;

    if(decimal >= 0.0001)             //判断是否为小数
    {
        i++;
        temp[i]='.';                //加小数点
        i++;
        data = (int)(decimal * 1000);
        temp[i] = 48 + data / 100;
        data = data % 100;
        i++;

        if(data > 0)
        {
            temp[i] = 48 + data / 10;
            data = data % 10;
        }

        if(data >= 0)
        {
            i++;
            temp[i] = data + 48;
        }
    }

    i++;
    temp[i]='\0';
    OLED_P8x16Str(x,y,point);
}

